## config/boards/shields/isopad/Kconfig.defconfig
```kconfig
# Copyright (c) 2021 Dan Thomas
# SPDX-License-Identifier: MIT

if SHIELD_ISOPAD

config ZMK_KEYBOARD_NAME
    default "ISOPad"

endif
```

## config/boards/shields/isopad/Kconfig.shield
```kconfig
 #
 # Copyright (c) 2021 Dan Thomas
 #
 # SPDX-License-Identifier: MIT
 #

config SHIELD_ISOPAD
    def_bool $(shields_list_contains,isopad)
```
